## config/boards/shields/penny/Kconfig.defconfig
```kconfig
if SHIELD_PENNY_LEFT

# Name must be less than 16 characters long!
config ZMK_KEYBOARD_NAME
    default "Penny"

config ZMK_SPLIT_ROLE_CENTRAL
    default y

endif

if SHIELD_PENNY_LEFT || SHIELD_PENNY_RIGHT

config ZMK_SPLIT
    default y

config CONFIG_ZMK_SPLIT_BLE_CENTRAL_BATTERY_LEVEL_PROXY
    default y

config CONFIG_ZMK_SPLIT_BLE_CENTRAL_BATTERY_LEVEL_FETCHING
    default y

endif
```

## config/boards/shields/penny/Kconfig.shield
```kconfig
# No whitespace after the comma or in your part name!
config SHIELD_PENNY_LEFT
    def_bool $(shields_list_contains,penny_left)

# No whitespace after the comma or in your part name!
config SHIELD_PENNY_RIGHT
    def_bool $(shields_list_contains,penny_right)
```
